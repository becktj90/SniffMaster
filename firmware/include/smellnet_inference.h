/**
 * smellnet_inference.h  —  SmellNet on-device inference for SniffMaster Pro
 * ============================================================================
 * Drop-in replacement for the heuristic scoreOdors() function.
 * Requires: smellnet_model_data.h (generated by sniffmaster_train.py)
 *
 * No external libraries needed. Implements a 4-layer MLP in ~80 lines of C++
 * using the float32 weight arrays from smellnet_model_data.h.
 *
 * HOW TO USE:
 *   1. Copy smellnet_model_data.h and this file into your sketch folder.
 *   2. In sketch_apr3a.ino, add near the top:
 *        #define USE_ML_SCORING
 *        #include "smellnet_model_data.h"
 *        #include "smellnet_inference.h"
 *   3. In setup(), add:
 *        smellnet_init();
 *   4. Replace the scoreOdors() call in loop() with:
 *        scoreOdors(vocSmooth, iaq, co2, tempF, hum,
 *                   pressure/100.0f, gasR, dVoc, scores);
 *      (Note: pressure now in hPa; two extra params vs. original signature)
 *
 * ARCHITECTURE (must match training script):
 *   Input  : 10 features (after normalisation)
 *   Layer 0: Dense 10→64, ReLU
 *   Layer 1: Dense 64→64, ReLU
 *   Layer 2: Dense 64→32, ReLU
 *   Layer 3: Dense 32→12, Sigmoid
 *   Output : 12 odor confidence scores (0.0–1.0), returned × 100 as uint8_t
 *
 * MEMORY:
 *   Flash (const arrays): ~29 KB  (model weights stored in RODATA)
 *   SRAM  (activations) : ~640 B  (two float[64] ping-pong buffers)
 *   Inference time      : ~2 ms on ESP32-C3 @ 160 MHz (FPU emulation)
 *                         ~0.5 ms on ESP32-S3 @ 240 MHz (hardware FPU)
 *
 * ALTERNATIVE — TFLite / EloquentTinyML:
 *   If you prefer using the standard TFLite runtime, use the generated
 *   smellnet_tflite_data.h instead and follow the EloquentTinyML quick-start:
 *     https://github.com/eloquentarduino/EloquentTinyML
 *   Install library: EloquentTinyML (Arduino Library Manager)
 *   Then replace the init/inference below with:
 *     #include <EloquentTinyML.h>
 *     #include "smellnet_tflite_data.h"
 *     Eloquent::TinyML::TFLite<10, 12, 32*1024> ml;
 *     // in setup():  ml.begin(smellnet_tflite_data);
 *     // inference:   ml.predict(input_f, output_f);
 */

#pragma once
#ifndef USE_ML_SCORING
  #error "Include smellnet_inference.h only when USE_ML_SCORING is defined."
#endif

#include <math.h>   // expf(), fabsf()
#include "smellnet_model_data.h"

// ── Activation buffers in SRAM (ping-pong, never both needed at once) ────────
static float _sn_a[64];   // layer 0/1 activations (max width = 64)
static float _sn_b[64];   // layer 1/2 activations
static float _sn_c[32];   // layer 2 activations
static float _sn_out[12]; // layer 3 output

// ── Fast sigmoid via rational approximation (< 0.2% error for |x| < 5) ──────
// More accurate than the tanh hack, avoids expf() on the ESP32-C3 soft-FPU.
inline static float _sn_sigmoid(float x) {
  if (x >  8.0f) return 1.0f;
  if (x < -8.0f) return 0.0f;
  float ax = fabsf(x);
  float denom = 1.0f + ax + 0.5f * ax * ax + 0.125f * ax * ax * ax;
  float r = 0.5f + 0.5f * (x / denom);
  return r < 0.0f ? 0.0f : (r > 1.0f ? 1.0f : r);
}

inline static float _sn_relu(float x) { return x > 0.0f ? x : 0.0f; }
inline static float _sn_clampf(float x, float lo, float hi) {
  return x < lo ? lo : (x > hi ? hi : x);
}

// ── Matrix-vector multiply + bias + activation ────────────────────────────────
// W[OUT][IN] stored row-major.  y[i] = act(sum_j W[i][j]*x[j] + b[i])
template<int OUT, int IN>
static void _sn_layer_relu(const float W[][IN], const float* b,
                            const float* x, float* y) {
  for (int i = 0; i < OUT; i++) {
    float acc = b[i];
    const float* row = W[i];
    for (int j = 0; j < IN; j++) acc += row[j] * x[j];
    y[i] = _sn_relu(acc);
  }
}

template<int OUT, int IN>
static void _sn_layer_sigmoid(const float W[][IN], const float* b,
                               const float* x, float* y) {
  for (int i = 0; i < OUT; i++) {
    float acc = b[i];
    const float* row = W[i];
    for (int j = 0; j < IN; j++) acc += row[j] * x[j];
    y[i] = _sn_sigmoid(acc);
  }
}

// ── One-time initialisation ───────────────────────────────────────────────────
static bool _sn_ready = false;
void smellnet_init() {
  _sn_ready = true;
  // Nothing to allocate — all buffers are static.
  // Add a Serial check here if debugging:
  // Serial.printf("SmellNet ready. SRAM for activations: %d B\n",
  //               sizeof(_sn_a)+sizeof(_sn_b)+sizeof(_sn_c)+sizeof(_sn_out));
}

// ── Main inference function ───────────────────────────────────────────────────
/**
 * scoreOdors() — ML-based multi-label odor classifier
 *
 * Replaces the heuristic scoreOdors() in sketch_apr3a.ino.
 * Same output format: uint8_t scores[12], values 0–100.
 *
 * @param voc         BSEC2 breath VOC equivalent (ppm)
 * @param iaq         BSEC2 IAQ 0–500
 * @param co2         BSEC2 CO2 equivalent (ppm)
 * @param tempF       Heat-compensated temperature (°F)
 * @param humidity    Heat-compensated humidity (%RH)
 * @param pressureHPa Barometric pressure (hPa)  ← NOTE: hPa, not Pa
 * @param gasR        Raw MOX gas resistance (Ω)
 * @param dVoc        |Δ smoothed VOC| per update cycle (ppm)
 * @param scores      Output: 12 confidence values 0–100
 */
void scoreOdors(float voc, float iaq, float co2, float tempF,
                float humidity, float pressureHPa, float gasR, float dVoc,
                uint8_t scores[12]) {
  if (!_sn_ready) {
    // Fallback: all zeros until initialised
    for (int i = 0; i < 12; i++) scores[i] = 0;
    return;
  }

  // ── Build raw feature vector [voc, iaq, co2, tempF, hum, hpa,
  //                              log(gasR+1), dvoc, iaq/voc, voc/iaq]
  // Clamp to plausible indoor ranges first. The exported model was trained
  // on a much broader distribution than a quiet home, so clipping reduces
  // runaway z-scores from bad units, warmup noise, or wild transient values.
  float feat[10];
  feat[0] = _sn_clampf(voc,         0.0f,   60.0f);
  feat[1] = _sn_clampf(iaq,         0.0f,  500.0f);
  feat[2] = _sn_clampf(co2,       350.0f, 5000.0f);
  feat[3] = _sn_clampf(tempF,      40.0f,  110.0f);
  feat[4] = _sn_clampf(humidity,    5.0f,   95.0f);
  feat[5] = _sn_clampf(pressureHPa, 850.0f, 1085.0f);
  feat[6] = log10f(_sn_clampf(gasR, 100.0f, 1000000.0f) + 1.0f);
  feat[7] = _sn_clampf(dVoc,        0.0f,   25.0f);
  feat[8] = _sn_clampf(feat[1] / fmaxf(feat[0], 1.0f), 0.0f, 12.0f);
  feat[9] = _sn_clampf(feat[0] / fmaxf(feat[1], 1.0f), 0.0f,  6.0f);

  // ── Z-score normalise using training statistics
  float x[10];
  for (int i = 0; i < 10; i++)
    x[i] = (feat[i] - SMELLNET_MEAN[i]) / (SMELLNET_STD[i] + 1e-8f);

  // ── Forward pass
  _sn_layer_relu  <64, 10>(SMELLNET_W0, SMELLNET_B0, x,     _sn_a);
  _sn_layer_relu  <64, 64>(SMELLNET_W1, SMELLNET_B1, _sn_a, _sn_b);
  _sn_layer_relu  <32, 64>(SMELLNET_W2, SMELLNET_B2, _sn_b, _sn_c);
  _sn_layer_sigmoid<12,32>(SMELLNET_W3, SMELLNET_B3, _sn_c, _sn_out);

  // ── Map sigmoid output (0–1) → uint8_t (0–100)
  for (int i = 0; i < 12; i++) {
    int v = (int)(_sn_out[i] * 100.0f + 0.5f);
    scores[i] = (uint8_t)(v < 0 ? 0 : v > 100 ? 100 : v);
  }
}
